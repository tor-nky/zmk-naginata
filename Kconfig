## Kconfig
```kconfig
config NAGINATA
    bool "Enable Naginata"
    default y
    
if NAGINATA

config NAGINATA_PERSISTENT_STATE
    bool "Naginata Persistent State"
    default y
    select SETTINGS
    help
      Enable persistent storage of Naginata state across reboots.
      This feature requires CONFIG_SETTINGS to be enabled.

endif
```
